## configs/smdk2440_defconfig
```kconfig
# Architecture
BR2_arm=y
BR2_arm920t=y

# Serial port
BR2_TARGET_GENERIC_GETTY=y
BR2_TARGET_GENERIC_GETTY_PORT="ttySAC0"

# Filesystem
BR2_TARGET_ROOTFS_JFFS2=y
BR2_TARGET_ROOTFS_JFFS2_NANDFLASH_16K=y
BR2_TARGET_ROOTFS_JFFS2_PAGESIZE=0x800
BR2_TARGET_ROOTFS_JFFS2_EBSIZE=0x20000
BR2_TARGET_ROOTFS_JFFS2_NOCLEANMARKER=y
BR2_TARGET_ROOTFS_JFFS2_LE=y
BR2_TARGET_ROOTFS_TAR=y

# Linux headers same as kernel, a 3.4 series
BR2_PACKAGE_HOST_LINUX_HEADERS_CUSTOM_3_4=y

# Bootloader
BR2_TARGET_UBOOT=y
BR2_TARGET_UBOOT_BOARDNAME="smdk2440"
BR2_TARGET_UBOOT_CUSTOM_VERSION=y
BR2_TARGET_UBOOT_CUSTOM_VERSION_VALUE="2012.04.01"
BR2_TARGET_UBOOT_PATCH="./patches/u-boot-2012.04.01.patch"
#BR2_TARGET_UBOOT_CUSTOM_TARBALL=y
#BR2_TARGET_UBOOT_CUSTOM_TARBALL_LOCATION="file:///home/fredy/workspace/jz/buildroot/u-boot-v2012.04.01.tar.gz"

#
# Kernel
#
BR2_LINUX_KERNEL=y
BR2_LINUX_KERNEL_CUSTOM_VERSION=y
BR2_LINUX_KERNEL_CUSTOM_VERSION_VALUE="3.4.2"
BR2_LINUX_KERNEL_DEFCONFIG="smdk2440"
BR2_LINUX_KERNEL_UIMAGE=y
BR2_LINUX_KERNEL_PATCH="./patches/linux-3.4.2.patch"

#
# Toolchain
#
BR2_GCC_VERSION_4_8_X=y
BR2_TOOLCHAIN_BUILDROOT_GLIBC=y

#
# Build options
#
BR2_WGET="wget --passive-ftp -nd -t 3 --no-check-certificate"
```
